## configs/jz2440_defconfig
```kconfig
BR2_arm=y
BR2_arm920t=y
BR2_TOOLCHAIN_EXTERNAL=y
BR2_TOOLCHAIN_EXTERNAL_CUSTOM=y
BR2_TOOLCHAIN_EXTERNAL_PATH="$(TOPDIR)/board/jz2440/toolchain/4.4.3"
BR2_TOOLCHAIN_EXTERNAL_GCC_4_4=y
BR2_TOOLCHAIN_EXTERNAL_CUSTOM_GLIBC=y
BR2_TARGET_GENERIC_HOSTNAME="jz2440"
BR2_LINUX_KERNEL=y
BR2_LINUX_KERNEL_CUSTOM_TARBALL=y
BR2_LINUX_KERNEL_CUSTOM_TARBALL_LOCATION="linux-3.4.2.tar.bz2"
BR2_LINUX_KERNEL_PATCH="$(TOPDIR)/board/jz2440/kernel/patch"
BR2_LINUX_KERNEL_USE_CUSTOM_CONFIG=y
BR2_LINUX_KERNEL_CUSTOM_CONFIG_FILE="$(TOPDIR)/board/jz2440/kernel/config_ok"
BR2_LINUX_KERNEL_UIMAGE=y
BR2_TARGET_ROOTFS_YAFFS2=y
BR2_TARGET_UBOOT=y
BR2_TARGET_UBOOT_BOARDNAME="smdk2440"
BR2_TARGET_UBOOT_CUSTOM_TARBALL=y
BR2_TARGET_UBOOT_CUSTOM_TARBALL_LOCATION="u-boot-2012.04.01.tar.bz2"
BR2_TARGET_UBOOT_PATCH="$(TOPDIR)/board/jz2440/uboot/uboot.patch"
```
